## drivers/input/touchscreen/chipone_tddi_v2_mmi/Kconfig
```kconfig
# SPDX-License-Identifier: GPL-2.0-only

config TOUCHSCREEN_CHIPONE_V2_MMI
	tristate "CHIPONE TDDI V2 Touchscreen"
	depends on SPI
	help
	  Say Y here if you have a Chipone flash touchscreen connected
	  to your system by SPI bus.

	  If unsure, say N.

config TOUCHSCREEN_CHIPONE_V2_MMI_ESD
	bool "ESD detection"
	depends on TOUCHSCREEN_CHIPONE_V2_MMI
	default n
	help
	  Say Y here if you want to have ESD detection support.

config TOUCHSCREEN_CHIPONE_V2_MMI_ENABLE_DOUBLE_TAP
	bool "Enable double tap"
	depends on TOUCHSCREEN_CHIPONE_V2_MMI
	default n
	help
	  Say Y here if you want to have double tap support.

config TOUCHSCREEN_CHIPONE_V2_MMI_GTP_LAST_TIME
	bool "GTP last time"
	depends on TOUCHSCREEN_CHIPONE_V2_MMI
	default n
	help
	  Say Y here if you want to have GTP last time support.

config TOUCHSCREEN_CHIPONE_V2_MMI_STOWED_MODE_EN
	bool "Enable stowed mode"
	depends on TOUCHSCREEN_CHIPONE_V2_MMI
	default n
	help
	  Say Y here if you want to have stowed mode support.

config TOUCHSCREEN_CHIPONE_V2_MMI_PM_BRL_SPI
	bool "SPI interface for touchscreen"
	depends on TOUCHSCREEN_CHIPONE_V2_MMI
	default n
	help
	  Say Y here if you want to have SPI interface support.

config TOUCHSCREEN_CHIPONE_V2_MMI_CHECK_DEVICE_BOOTMODE
	bool "Check device boot mode"
	depends on TOUCHSCREEN_CHIPONE_V2_MMI
	default n
	help
	  Say Y here if you want to have device boot mode check support.
```

## drivers/misc/awinic/sarsensor/Kconfig
```kconfig
# SPDX-License-Identifier: GPL-2.0-only

config AWINIC_SARSENSOR
	tristate "Awinic SAR sensor"
	depends on I2C
	help
	  Awinic capacitive SAR sensor (aw9610x/aw9620x/aw963xx), used to
	  back off the radio when the phone is held close to the body.

	  Say Y to build it into the kernel.
```

## drivers/misc/fm/Kconfig
```kconfig
# SPDX-License-Identifier: GPL-2.0-only

config RADIO_ELNA
	tristate "Motorola FM ELNA control"
	help
	  Controls the FM radio external LNA pin state, exposed to the radio
	  HAL through sysfs.

	  Say Y to build it into the kernel.
```

## drivers/misc/ldo_vibrator_mmi/Kconfig
```kconfig
# SPDX-License-Identifier: GPL-2.0-only

config LDO_VIBRATOR_MMI
	tristate "Motorola LDO vibrator"
	depends on LEDS_CLASS
	help
	  Motorola vibrator driven through an LDO enable GPIO, exposed as an
	  LED class device so the vibrator HAL can drive it.

	  Say Y to build it into the kernel.
```

## drivers/nfc/sec_nfc/Kconfig
```kconfig
# SPDX-License-Identifier: GPL-2.0-only

config SEC_NFC
	tristate "Samsung NFC driver"
	depends on NFC && I2C
	help
	  Samsung S3NRN4V NFC controller, driven from the Motorola NFC HAL
	  through /dev/sec-nfc.

	  Say Y to build it into the kernel.

config SEC_NFC_PRODUCT_N5
	bool "Samsung NFC N5 pin layout"
	depends on SEC_NFC
	default y
	help
	  Select the N5-family pin and power layout, which is the one used by
	  fogos.

config SEC_NFC_IF_I2C
	bool "Samsung NFC on I2C"
	depends on SEC_NFC
	default y
	help
	  The controller is wired on I2C rather than UART.

config SEC_NFC_WAKE_LOCK
	bool "Samsung NFC wake lock"
	depends on SEC_NFC
	default n
	help
	  Hold a wake lock while NFC is active. Fogos does not need it.
```

## drivers/power/mmi-smbcharger-iio/Kconfig
```kconfig
# SPDX-License-Identifier: GPL-2.0-only

config MMI_SMBCHARGER_IIO
	tristate "Motorola SMB charger IIO driver"
	depends on POWER_SUPPLY
	help
	  Motorola charger driver for the SMB5 family, exposing the charging
	  state used by the fogos charger and USB stack.

	  Say Y to build it into the kernel.
```

## techpack/audio/Kconfig
```kconfig
# SPDX-License-Identifier: GPL-2.0-only

config QTI_AUDIO_LAHAINA
	bool "Qualcomm APR audio driver (techpack/audio) for lahaina"
	depends on SND_SOC && ARCH_QCOM && RPMSG && !QCOM_APR
	select SND_SOC_COMPRESS
	select SND_HWDEP
	select REGMAP_MMIO
	select REGMAP_I2C
	help
	  Build the Qualcomm APR/q6 audio-kernel techpack (APR over glink,
	  q6 AFE/ASM/ADM/voice/LSM, ASoC platform and DAI drivers, bolero
	  macros, soundwire, WCD938x and the lahaina machine driver) into
	  the kernel with the lahaina feature set from
	  config/lahainaauto.conf.

if QTI_AUDIO_LAHAINA

config SND_PRI_MI2S_AW882XX
	bool "For aw882xx smartpa pri mi2s config"
	default n
	help
	  Enable it only aw882xx smartpa is connected on pri mi2s.

config SND_ENABLE_QCOM_PMIC_HAPTIC
	bool "Enable qcom pmic haptic"
	default n
	help
	  Enable it when qcom pmic haptic is used.

config HAPTIC_POWER_ON
	bool "haptic when power on"
	default n
	help
	  Enable it when haptic power on.

config SND_SOC_FS1815
	bool "Foursemi FS1815 smart PA"
	depends on I2C
	help
	  Enable the Foursemi FS1815 smart PA used on fogos for the
	  receiver and the speaker. Its oscillator is fed from the codec,
	  so the driver alone does not make sound, but it has to be built
	  in for the fs1815 snd card to probe.

config AW882XX_DRIVER_V1
	bool "Use aw882xx driver version 1.*"
	default n
	help
	  Enable it only use aw882xx driver version 1.*.

config AW882XX_DUAL_SMARTPA
	bool "Use dual smartpa"
	default n
	help
	  Enable it only use dual smartpa.

config AW882XX_PARAMS_FROM_BIN
	bool "params is stored in bin file"
	default n
	help
	  Enable it only for params of smartPA is stored in bin file.

endif
```

## techpack/display/Kconfig
```kconfig
# SPDX-License-Identifier: GPL-2.0-only

config QTI_DISPLAY_LAHAINA
	bool "Qualcomm SDE/DSI display driver (techpack/display) for lahaina"
	depends on DRM && ARCH_QCOM && !DRM_MSM
	select DRM_KMS_HELPER
	select DRM_MIPI_DSI
	select SYNC_FILE
	select QCOM_PANEL_EVENT_NOTIFIER
	help
	  Build the Qualcomm display-drivers techpack (msm_drm: SDE, DSI,
	  5nm DSI PLL, RSC, writeback) into the kernel with the lahaina
	  feature set from config/lahainadisp.conf. The driver keeps the
	  msm_drm module name, so the msm_drm.dsi_display0= panel selection
	  from the bootloader still applies.

config QTI_DISPLAY_BLAIR
	bool "Qualcomm SDE/DSI display driver (techpack/display) for blair"
	depends on DRM && ARCH_QCOM && !DRM_MSM
	select DRM_KMS_HELPER
	select DRM_MIPI_DSI
	select SYNC_FILE
	select QCOM_PANEL_EVENT_NOTIFIER
	help
	  Build the Qualcomm display-drivers techpack (msm_drm: SDE, DSI,
	  10nm DSI PLL, rotator) into the kernel with the blair/hoLi
	  feature set from config/blairdisp.conf. The driver keeps the
	  msm_drm module name, so the msm_drm.dsi_display0= panel selection
	  from the bootloader still applies.
```

## techpack/wlan/Kconfig
```kconfig
# SPDX-License-Identifier: GPL-2.0-only

config QTI_WLAN
	bool "Qualcomm WLAN stack"
	depends on ARCH_QCOM
	help
	  Build the CNSS platform drivers and the qcacld-3.0 WLAN host driver
	  from techpack/wlan into the kernel.

if QTI_WLAN

source "techpack/wlan/platform/cnss2/Kconfig"
source "techpack/wlan/platform/icnss2/Kconfig"
source "techpack/wlan/platform/cnss_genl/Kconfig"
source "techpack/wlan/platform/cnss_prealloc/Kconfig"
source "techpack/wlan/platform/cnss_utils/Kconfig"

config QCA_CLD_WLAN
	tristate "Qualcomm Atheros CLD WLAN module"
	help
	  Add support for the Qualcomm Atheros CLD WLAN host driver. Its feature
	  flags come from the qcacld-3.0 profile selected by the Kbuild
	  (blair_gki_wlan for fogos), not from Kconfig.

endif
```
